## os/Config.in
```kconfig
source "$BR2_EXTERNAL_LOOPHOLE_LABS_SHIM_OS_PATH/package/drafter-liveness/Config.in"
source "$BR2_EXTERNAL_LOOPHOLE_LABS_SHIM_OS_PATH/package/drafter-agent/Config.in"
source "$BR2_EXTERNAL_LOOPHOLE_LABS_SHIM_OS_PATH/package/oci-runtime-bundle/Config.in"
```

## os/configs/drafteros-firecracker-x86_64_defconfig
```kconfig
BR2_x86_64=y
BR2_PACKAGE_HOST_LINUX_HEADERS_CUSTOM_6_1=y
BR2_CCACHE=y
BR2_TARGET_GENERIC_HOSTNAME="drafterhost"
BR2_TARGET_GENERIC_ISSUE="Welcome to Loophole Labs DrafterOS"
BR2_INIT_SYSTEMD=y
BR2_SYSTEM_DEFAULT_PATH="/bin:/sbin:/usr/bin:/usr/sbin"
BR2_ROOTFS_OVERLAY="$(BR2_EXTERNAL_LOOPHOLE_LABS_DRAFTER_OS_PATH)/board/firecracker-x86_64/overlay/"
BR2_LINUX_KERNEL=y
BR2_LINUX_KERNEL_CUSTOM_VERSION=y
BR2_LINUX_KERNEL_CUSTOM_VERSION_VALUE="6.1.89"
BR2_LINUX_KERNEL_USE_CUSTOM_CONFIG=y
BR2_LINUX_KERNEL_CUSTOM_CONFIG_FILE="$(BR2_EXTERNAL_LOOPHOLE_LABS_DRAFTER_OS_PATH)/board/firecracker-x86_64/kernel.config"
BR2_LINUX_KERNEL_VMLINUX=y
BR2_PACKAGE_HAVEGED=y
BR2_PACKAGE_CHRONY=y
# BR2_PACKAGE_SYSTEMD_TIMESYNCD is not set
BR2_TARGET_ROOTFS_EXT2=y
BR2_TARGET_ROOTFS_EXT2_4=y
BR2_TARGET_ROOTFS_EXT2_SIZE="384M"
# BR2_TARGET_ROOTFS_TAR is not set
BR2_PACKAGE_DRAFTER_LIVENESS=y
BR2_PACKAGE_DRAFTER_AGENT=y
BR2_PACKAGE_OCI_RUNTIME_BUNDLE=y
```

## os/configs/drafteros-firecracker-x86_64_pvm_defconfig
```kconfig
BR2_x86_64=y
BR2_KERNEL_HEADERS_VERSION=y
BR2_DEFAULT_KERNEL_VERSION="6.8.12"
BR2_GNU_MIRROR="https://mirrors.kernel.org/gnu"
BR2_CCACHE=y
BR2_TARGET_GENERIC_HOSTNAME="drafterhost"
BR2_TARGET_GENERIC_ISSUE="Welcome to Loophole Labs DrafterOS"
BR2_INIT_SYSTEMD=y
BR2_SYSTEM_DEFAULT_PATH="/bin:/sbin:/usr/bin:/usr/sbin"
BR2_ROOTFS_OVERLAY="$(BR2_EXTERNAL_LOOPHOLE_LABS_DRAFTER_OS_PATH)/board/firecracker-x86_64_pvm/overlay/"
BR2_LINUX_KERNEL=y
BR2_LINUX_KERNEL_CUSTOM_TARBALL=y
BR2_LINUX_KERNEL_CUSTOM_TARBALL_LOCATION="https://github.com/virt-pvm/linux/archive/819c84c7335cdcb9fe79444aff198071e13bf490.tar.gz"
BR2_LINUX_KERNEL_USE_CUSTOM_CONFIG=y
BR2_LINUX_KERNEL_CUSTOM_CONFIG_FILE="$(BR2_EXTERNAL_LOOPHOLE_LABS_DRAFTER_OS_PATH)/board/firecracker-x86_64_pvm/kernel.config"
BR2_LINUX_KERNEL_VMLINUX=y
BR2_PACKAGE_HAVEGED=y
BR2_PACKAGE_CHRONY=y
# BR2_PACKAGE_SYSTEMD_TIMESYNCD is not set
BR2_TARGET_ROOTFS_EXT2=y
BR2_TARGET_ROOTFS_EXT2_4=y
BR2_TARGET_ROOTFS_EXT2_SIZE="384M"
# BR2_TARGET_ROOTFS_TAR is not set
BR2_PACKAGE_DRAFTER_LIVENESS=y
BR2_PACKAGE_DRAFTER_AGENT=y
BR2_PACKAGE_OCI_RUNTIME_BUNDLE=y
```

## os/configs/drafteros-k3s-firecracker-aarch64_defconfig
```kconfig
BR2_aarch64=y
BR2_PACKAGE_HOST_LINUX_HEADERS_CUSTOM_6_1=y
BR2_GNU_MIRROR="https://mirrors.kernel.org/gnu"
BR2_CCACHE=y
BR2_TARGET_GENERIC_HOSTNAME="drafterhost"
BR2_TARGET_GENERIC_ISSUE="Welcome to Loophole Labs DrafterOS k3s"
BR2_INIT_SYSTEMD=y
BR2_SYSTEM_DEFAULT_PATH="/bin:/sbin:/usr/bin:/usr/sbin"
BR2_ROOTFS_OVERLAY="$(BR2_EXTERNAL_LOOPHOLE_LABS_DRAFTER_OS_PATH)/board/firecracker-aarch64/overlay/"
BR2_LINUX_KERNEL=y
BR2_LINUX_KERNEL_CUSTOM_VERSION=y
BR2_LINUX_KERNEL_CUSTOM_VERSION_VALUE="6.1.115"
BR2_LINUX_KERNEL_USE_CUSTOM_CONFIG=y
BR2_LINUX_KERNEL_CUSTOM_CONFIG_FILE="$(BR2_EXTERNAL_LOOPHOLE_LABS_DRAFTER_OS_PATH)/board/firecracker-aarch64/kernel.config"
BR2_LINUX_KERNEL_VMLINUX=y
BR2_PACKAGE_CA_CERTIFICATES=y
BR2_PACKAGE_HAVEGED=y
BR2_PACKAGE_CHRONY=y
BR2_PACKAGE_IPTABLES=y
BR2_PACKAGE_IPTABLES_BPF_NFSYNPROXY=y
BR2_PACKAGE_IPTABLES_NFTABLES=y
BR2_PACKAGE_NFTABLES=y
# BR2_PACKAGE_SYSTEMD_TIMESYNCD is not set
BR2_TARGET_ROOTFS_EXT2=y
BR2_TARGET_ROOTFS_EXT2_4=y
BR2_TARGET_ROOTFS_EXT2_SIZE="2048M"
# BR2_TARGET_ROOTFS_TAR is not set
BR2_PACKAGE_DRAFTER_LIVENESS=y
BR2_PACKAGE_DRAFTER_AGENT=y
BR2_PACKAGE_DRAFTER_AGENT_SYSTEMD_DEPENDENCY="k3s.service"
BR2_PACKAGE_K3S=y
```

## os/configs/drafteros-k3s-server-firecracker-x86_64_pvm_defconfig
```kconfig
BR2_x86_64=y
BR2_KERNEL_HEADERS_6_6=y
BR2_GNU_MIRROR="https://mirrors.kernel.org/gnu"
BR2_CCACHE=y
BR2_TARGET_GENERIC_HOSTNAME="drafterhost"
BR2_TARGET_GENERIC_ISSUE="Welcome to Loophole Labs DrafterOS k3s Server"
BR2_INIT_SYSTEMD=y
BR2_SYSTEM_DEFAULT_PATH="/bin:/sbin:/usr/bin:/usr/sbin"
BR2_ROOTFS_OVERLAY="$(BR2_EXTERNAL_LOOPHOLE_LABS_DRAFTER_OS_PATH)/board/firecracker-x86_64_pvm/overlay/"
BR2_LINUX_KERNEL=y
BR2_LINUX_KERNEL_CUSTOM_TARBALL=y
BR2_LINUX_KERNEL_CUSTOM_TARBALL_LOCATION="https://github.com/loopholelabs/linux-pvm/archive/5488345cc923c83cd7285defbc1f41072ee6dcd0.tar.gz"
BR2_LINUX_KERNEL_USE_CUSTOM_CONFIG=y
BR2_LINUX_KERNEL_CUSTOM_CONFIG_FILE="$(BR2_EXTERNAL_LOOPHOLE_LABS_DRAFTER_OS_PATH)/board/firecracker-x86_64_pvm/kernel.config"
BR2_LINUX_KERNEL_VMLINUX=y
BR2_PACKAGE_CA_CERTIFICATES=y
BR2_PACKAGE_HAVEGED=y
BR2_PACKAGE_CHRONY=y
BR2_PACKAGE_IPTABLES=y
BR2_PACKAGE_IPTABLES_BPF_NFSYNPROXY=y
BR2_PACKAGE_IPTABLES_NFTABLES=y
BR2_PACKAGE_NFTABLES=y
# BR2_PACKAGE_SYSTEMD_TIMESYNCD is not set
BR2_TARGET_ROOTFS_EXT2=y
BR2_TARGET_ROOTFS_EXT2_4=y
BR2_TARGET_ROOTFS_EXT2_SIZE="2048M"
# BR2_TARGET_ROOTFS_TAR is not set
BR2_PACKAGE_DRAFTER_LIVENESS=y
BR2_PACKAGE_DRAFTER_AGENT=y
BR2_PACKAGE_DRAFTER_AGENT_SYSTEMD_DEPENDENCY="k3s.service"
BR2_PACKAGE_K3S=y
```

## os/os/Config.in
```kconfig
source "$BR2_EXTERNAL_LOOPHOLE_LABS_DRAFTER_OS_PATH/package/drafter-liveness/Config.in"
source "$BR2_EXTERNAL_LOOPHOLE_LABS_DRAFTER_OS_PATH/package/drafter-agent/Config.in"
source "$BR2_EXTERNAL_LOOPHOLE_LABS_DRAFTER_OS_PATH/package/oci-runtime-bundle/Config.in"
source "$BR2_EXTERNAL_LOOPHOLE_LABS_DRAFTER_OS_PATH/package/k3s/Config.in"
```

## os/os/package/oci-runtime-bundle/Config.in
```kconfig
config BR2_PACKAGE_OCI_RUNTIME_BUNDLE
    bool "oci-runtime-bundle"
    select BR2_PACKAGE_CRUN
    help
      OCI runtime bundle started by crun

if BR2_PACKAGE_OCI_RUNTIME_BUNDLE

config BR2_PACKAGE_OCI_RUNTIME_BUNDLE_MOUNT_DIR
    string "oci-runtime-bundle-mount-dir"
    default "oci-runtime-bundle"
    help
      Root-relative directory (must not be nested) to mount the OCI runtime bundle to (will be added to the fstab)

config BR2_PACKAGE_OCI_RUNTIME_BUNDLE_MOUNT_LABEL
    string "oci-runtime-bundle-mount-label"
    default "oci"
    help
      Label of the EXT4 disk containing the OCI runtime bundle to mount

config BR2_PACKAGE_OCI_RUNTIME_BUNDLE_CONTAINER_NAME
    string "oci-runtime-bundle-container-name"
    default "main"
    help
      Name to give to the container started by crun

config BR2_PACKAGE_OCI_RUNTIME_BUNDLE_SYSTEMD_INSTALL_DIR
    string "oci-runtime-bundle-systemd-install-dir"
    default "/usr/lib/systemd/system"
    help
      Directory to place the systemd unit file for the OCI runtime bundle service

endif
```

## os/package/drafter-agent/Config.in
```kconfig
config BR2_PACKAGE_DRAFTER_AGENT
    bool "drafter-agent"
    depends on BR2_PACKAGE_HOST_GO_TARGET_ARCH_SUPPORTS
    select BR2_PACKAGE_HOST_GO
    help
      Drafter agent daemon

if BR2_PACKAGE_DRAFTER_AGENT

config BR2_PACKAGE_DRAFTER_AGENT_VSOCK_PORT
    string "vsock-port"
    default "26"
    help
      The vsock port to connect to

config BR2_PACKAGE_DRAFTER_AGENT_BEFORE_SUSPEND_CMD
    string "before-suspend-cmd"
    default ""
    help
      Command to execute before suspending

config BR2_PACKAGE_DRAFTER_AGENT_AFTER_RESUME_CMD
    string "after-resume-cmd"
    default ""
    help
      Command to execute after resuming

config BR2_PACKAGE_DRAFTER_AGENT_SYSTEMD_DEPENDENCY
    string "systemd-dependency"
    default "oci-runtime-bundle.service"
    help
      The systemd service to wait for before starting

endif
```

## os/package/drafter-liveness/Config.in
```kconfig
config BR2_PACKAGE_DRAFTER_LIVENESS
    bool "drafter-liveness"
    depends on BR2_PACKAGE_HOST_GO_TARGET_ARCH_SUPPORTS
    select BR2_PACKAGE_HOST_GO
    help
      Drafter liveness daemon

if BR2_PACKAGE_DRAFTER_LIVENESS

config BR2_PACKAGE_DRAFTER_LIVENESS_VSOCK_PORT
    string "vsock-port"
    default "25"
    help
      The vsock port to connect to

config BR2_PACKAGE_DRAFTER_LIVENESS_SYSTEMD_DEPENDENCY
    string "systemd-dependency"
    default "drafter-agent.service"
    help
      The systemd service to wait for before starting

endif
```

## os/package/k3s/Config.in
```kconfig
config BR2_PACKAGE_K3S
    bool "k3s"
    depends on (BR2_x86_64 || BR2_arm64 || BR2_arm)
    help
      Lightweight Kubernetes

if BR2_PACKAGE_K3S

config BR2_PACKAGE_K3S_DOWNLOAD_BASE_URL
    string "download-base-url"
    default "https://github.com/k3s-io/k3s/releases/download"
    help
      The base URL to download the static k3s binary from

config BR2_PACKAGE_K3S_SYSTEMD_EXEC_START_ARGS
    string "exec-start-args"
    default "server --node-name=drafter-k3s-server-1 --token=mytoken --tls-san=192.168.124.220 --node-ip=192.168.124.220 --node-external-ip=192.168.124.220 --advertise-port=6443"
    help
      Arguments to k3s to use in the k3s systemd service

endif
```
